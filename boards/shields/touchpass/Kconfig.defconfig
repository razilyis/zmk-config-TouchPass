## boards/shields/touchpass/Kconfig.defconfig
```kconfig
if SHIELD_TOUCHPASS

config ZMK_KEYBOARD_NAME
    default "TouchPass for Zmk"

endif
```

## config/west.yml
```yaml
manifest:
  remotes:
    - name: zmkfirmware
      url-base: https://github.com/zmkfirmware
    - name: TouchPass
      url-base: https://github.com/razilyis
  projects:
    - name: zmk
      remote: zmkfirmware
      revision: v0.3
      import: app/west.yml
    - name: zmk-module-Fingerprint
      remote: TouchPass
      revision: main
  self:
    path: config
```
